## meta-proyecto1/conf/layer.conf
```bitbake
# We have a conf and classes directory, add to BBPATH
BBPATH =. "${LAYERDIR}:"

# We have recipes-* directories, add to BBFILES
BBFILES += "${LAYERDIR}/recipes-*/*/*.bb \
            ${LAYERDIR}/recipes-*/*/*.bbappend"

BBFILE_COLLECTIONS += "proyecto1"
BBFILE_PATTERN_proyecto1 = "^${LAYERDIR}/"
BBFILE_PRIORITY_proyecto1 = "5"

LAYERSERIES_COMPAT_proyecto1 = "dunfell"

# This should only be incremented on significant changes that will
# cause compatibility issues with other layers
LAYERVERSION_proyecto1 = "4"

#LAYERDEPENDS_proyecto1 = "core"

#REQUIRED_POKY_BBLAYERS_CONF_VERSION = "2"
```
